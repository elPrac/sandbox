## buildroot-external-syzbot/Config.in
```kconfig
source "$BR2_EXTERNAL_SYZBOT_PATH/package/syzbot/Config.in"
source "$BR2_EXTERNAL_SYZBOT_PATH/package/syzkaller/Config.in"
```

## buildroot-external-syzbot/configs/qemu_x86_64_syzbot_defconfig
```kconfig
BR2_x86_64=y
BR2_PACKAGE_OVERRIDE_FILE="../buildroot-external-syzbot/override.mk"
BR2_INIT_SYSTEMD=y
BR2_SYSTEM_DHCP="eth0"
BR2_SYSTEM_DEFAULT_PATH="/bin:/sbin:/usr/bin:/usr/sbin"
BR2_ROOTFS_OVERLAY="$(BR2_EXTERNAL_SYZBOT_PATH)/board/syzbot/rootfs_overlay"
BR2_ROOTFS_POST_BUILD_SCRIPT="board/qemu/x86_64/post-build.sh"
BR2_ROOTFS_POST_IMAGE_SCRIPT="$(BR2_EXTERNAL_SYZBOT_PATH)/board/qemu/post-image.sh"
BR2_ROOTFS_POST_SCRIPT_ARGS="$(BR2_DEFCONFIG)"
BR2_LINUX_KERNEL=y
BR2_LINUX_KERNEL_CUSTOM_VERSION=y
BR2_LINUX_KERNEL_CUSTOM_VERSION_VALUE="6.9.0-rc1"
BR2_LINUX_KERNEL_USE_CUSTOM_CONFIG=y
BR2_LINUX_KERNEL_CUSTOM_CONFIG_FILE="$(BR2_EXTERNAL_SYZBOT_PATH)/board/syzbot/linux.config"
BR2_LINUX_KERNEL_NEEDS_HOST_LIBELF=y
BR2_PACKAGE_BUSYBOX_CONFIG="$(BR2_EXTERNAL_SYZBOT_PATH)/board/syzbot/busybox.config"
BR2_PACKAGE_BABELTRACE2=y
BR2_PACKAGE_PCIUTILS=y
BR2_PACKAGE_USBUTILS=y
BR2_PACKAGE_LIBCAP_NG=y
BR2_PACKAGE_NCURSES_TARGET_PROGS=y
BR2_PACKAGE_POPT=y
BR2_PACKAGE_OPENSSH=y
BR2_PACKAGE_BASH=y
BR2_PACKAGE_UTIL_LINUX_SCHEDUTILS=y
BR2_TARGET_ROOTFS_EXT2=y
BR2_TARGET_ROOTFS_EXT2_SIZE="250M"
# BR2_TARGET_ROOTFS_TAR is not set
BR2_PACKAGE_HOST_QEMU=y
BR2_PACKAGE_HOST_QEMU_SYSTEM_MODE=y
BR2_PACKAGE_SYZBOT=y
BR2_PACKAGE_SYZBOT_REPRO_ID="14bbf9fa180000"
```

## buildroot-external-syzbot/package/syzbot/Config.in
```kconfig
config BR2_PACKAGE_SYZBOT
	bool "syzbot"
	help
	A pkg-recipe to build & install syzbot reproducers

if BR2_PACKAGE_SYZBOT

config BR2_PACKAGE_SYZBOT_C_REPRO_ID
	string "Reproducer C Identifier"
	help
	From syzbot report C reproducer 
	https://syzkaller.appspot.com/x/repro.c?x=<Identifier>

config BR2_PACKAGE_SYZBOT_SYZ_REPRO_ID
	string "Reproducer SYZ Identifier"
	depends on BR2_PACKAGE_SYZKALLER
	help
	From syzbot report SYZ reproducer 
	https://syzkaller.appspot.com/x/repro.syz?x=<Identifier>


endif
```

## buildroot-external-syzbot/package/syzkaller/Config.in
```kconfig
config BR2_PACKAGE_SYZKALLER
	bool "syzkaller"
	depends on BR2_PACKAGE_HOST_GO_TARGET_ARCH_SUPPORTS
	help
	A pkg-recipe for syzkaller
```
